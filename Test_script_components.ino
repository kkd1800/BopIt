#include <Arduino.h>
#include <oled.h>
#include <Wire.h>
#include <PCA9685.h>
#include <TM1637Display.h>

OLED display(A4, A5, NO_RESET_PIN, OLED::W_128, OLED::H_64, OLED::CTRL_SH1106, 0x3C);
TM1637Display seg(10, 9);  // CLK=D10, DIO=D9

// 42x48 bitmap (6 pages, 252 bytes)
static const uint8_t tieFighter[] PROGMEM =
{
  //     0,    1,    2,    3,    4,    5,    6,    7,    8,    9,   10,   11,   12,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   41
  // P0 r0-7
     255,    1,    1,    2,    2,    2,    2,  252,    4,    4,    4,    8,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  240,
  // P1 r8-15
     255,    4,    4,    4,    8,    8,    8,  255,    8,   16,   16,   16,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  255,
  // P2 r16-23
     255,    8,    8,    8,    8,    8,    8,  255,    8,   16,   16,   16,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  255,
  // P3 r24-31
     255,   16,   16,   16,   16,   16,   16,  255,   16,    8,    8,    8,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  255,
  // P4 r32-39
     255,   32,   32,   32,   16,   16,   16,  255,   16,    8,    8,    8,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  255,
  // P5 r40-47
     255,  128,  128,   64,   64,   64,   64,   63,   32,   32,   32,   16,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   15,
};

// 128x64 bitmap (8 pages, 1024 bytes)
static const uint8_t targetingDisplay[] PROGMEM =
{
  //     0,    1,    2,    3,    4,    5,    6,    7,    8,    9,   10,   11,   12,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  127
  // P0 r0-7
       0,    0,    0,    0,  128,   64,   32,   16,    8,    4,    4,    2,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    0,
  // P1 r8-15
       0,    0,  240,   14,    1,    0,    0,    0,    0,    0,    0,    0,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    0,
  // P2 r16-23
       0,    0,  255,    0,    0,    0,    0,    0,    0,    0,    0,    0,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    0,
  // P3 r24-31
       0,    0,  255,    0,    0,    0,    0,    0,    0,    0,    0,    0,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    0,
  // P4 r32-39
       0,    0,  255,    0,    0,    0,    0,    0,    0,    0,    0,    0,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    0,
  // P5 r40-47
       0,    0,  255,    0,    0,    0,    0,    0,    0,    0,    0,    0,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    0,
  // P6 r48-55
       0,    0,   15,  112,  128,    0,    0,    0,    0,    0,    0,    0,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    0,
  // P7 r56-63
       0,    0,    0,    0,    1,    2,    4,    8,   16,   32,   32,   64,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    0,
};

// ttp223 touch sensor pin
int touchPin = 4;

// rotary encoder pins
int CLK = 5;
int direc_enc = 6;

// button pin
int buttonPin = 7;

// touch sensor led pin
int touchLED = 8;

// PCA9685 channels for LEDs
#define TOUCH_LED    0   // ttp223 indicator
#define LED1         1   // shield level 1
#define LED2         2   // shield level 2
#define LED3         3   // shield level 3
#define LED4         4   // shield level 4
#define BUTTON_LED   5   // button indicator

PCA9685 pca9685;

// shield level starts at 0
int shieldLevel = 0;
int lastStateCLK;

// helper to turn a PCA9685 channel fully on or off
void setLED(uint8_t channel, bool state) {
  pca9685.setChannelDutyCycle(channel, state ? 100 : 0);
}

void setup() {

  delay(1000);
  display.begin();
  display.clear();
  display.draw_bitmap_P(0, 0, 128, 64, targetingDisplay);
  display.draw_bitmap_P(43,7,42,48,tieFighter);
  display.display();

  seg.setBrightness(4);
  seg.showNumberDec(shieldLevel, true);

  // set button pin as input
  pinMode(buttonPin, INPUT_PULLUP);

  // set touch sensor pin as input
  pinMode(touchPin, INPUT);

  // set encoder pins as inputs
  pinMode(CLK, INPUT_PULLUP);
  pinMode(direc_enc, INPUT_PULLUP);

  // setup PCA9685
  Wire.begin();
  pca9685.setupSingleDevice(Wire, 0x40);
  pca9685.setToFrequency(1000);

  // read the starting state of CLK
  lastStateCLK = digitalRead(CLK);
}

void loop() {

  // button logic
  if (digitalRead(buttonPin) == LOW) {
    setLED(BUTTON_LED, true);
  } else {
    setLED(BUTTON_LED, false);
  }

  // ttp223 touch sensor logic
  if (digitalRead(touchPin) == LOW) {
    setLED(TOUCH_LED, true);
  } else {
    setLED(TOUCH_LED, false);
  }

  // rotary encoder logic
  int currentStateCLK = digitalRead(CLK);

  if (currentStateCLK != lastStateCLK) {

    if (digitalRead(direc_enc) != currentStateCLK) {
      shieldLevel = shieldLevel + 1;
    } else {
      shieldLevel = shieldLevel - 1;
    }

    if (shieldLevel > 4) shieldLevel = 4;
    if (shieldLevel < 0) shieldLevel = 0;

    setLED(LED1, shieldLevel >= 1);
    setLED(LED2, shieldLevel >= 2);
    setLED(LED3, shieldLevel >= 3);
    setLED(LED4, shieldLevel >= 4);

    seg.showNumberDec(shieldLevel, true);  // update 7-segment on every change
  }

  // save the current state for next time
  lastStateCLK = currentStateCLK;
}
